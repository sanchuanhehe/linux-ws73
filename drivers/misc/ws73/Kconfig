## drivers/misc/ws73/Kconfig
```kconfig
# SPDX-License-Identifier: GPL-2.0-only
config WS73_CORE
	tristate
	select AUXILIARY_BUS
	select FW_LOADER
	select CRYPTO_LIB_SHA256
	help
	  Shared WS73 protocol helpers used by actual function consumers.
	  This component validates HCC records, chip replies and original
	  firmware, and provides bounded boot transaction sequencing.
	  It has no Bluetooth or Wi-Fi stack dependency. It also provides
	  the auxiliary BLE endpoint; publishing it requires qualified
	  initialization by the physical transport owner.

config WS73_KUNIT_TEST
	tristate "WS73 firmware and boot transaction tests" if !KUNIT_ALL_TESTS
	depends on KUNIT
	select WS73_CORE
	default KUNIT_ALL_TESTS
	help
	  Validate original firmware profiles and download transactions.
	  Run production hashing and chunk sequencing with synthetic data
	  and an injectable synchronous transport. No USB device is used.
	  Success does not establish boot identity or firmware execution.

config WS73_USB_IO
	tristate
	depends on USB

config WS73_USB
	tristate "WS73 USB boot and runtime identity observations"
	depends on USB
	select WS73_USB_IO
	select WS73_CORE
	help
	  Issue fixed HCC READM on a boot interface, or a one-shot HCC chip
	  and version query with independent RX on a five-endpoint runtime
	  interface. Validated function notifications are observations only.
	  This development path does not select firmware or enable
	  Bluetooth/Wi-Fi: boot/runtime compatibility remains unqualified.
	  No register write, generic register interface or reset is provided.

config WS73_HCI_KUNIT_TEST
	tristate "WS73 native HCI lifecycle test"
	depends on KUNIT && BT_WS73 && FAILSLAB
	help
	  Bind the actual auxiliary/HCI driver to synthetic backends in a
	  hardware-free VM. Check terminal failure, HCI setup queries, TX/RX
	  ownership, bounded queues and task-scoped allocation failures.
	  Controller replies exist only in the
	  explicit test model, never the production driver or USB backend.

config WS73_USB_BOOT_TEST
	tristate "WS73 synthetic USB boot download test"
	depends on USB && USB_DUMMY_HCD && DEBUG_KERNEL
	select WS73_CORE
	select WS73_USB_IO
	help
	  Execute the boot download sequencer using synthetic payloads over
	  actual URBs to a FunctionFS peer. Only the dummy_hcd controller and
	  a separate test USB ID can bind. Run only in a hardware-free VM.
	  This does not qualify real firmware, board setup or boot identity.
```

## drivers/net/wireless/hisilicon/Kconfig
```kconfig
# SPDX-License-Identifier: GPL-2.0-only
config WLAN_VENDOR_HISILICON
	bool "HiSilicon devices"
	default y
	help
	  Enable configuration options for HiSilicon wireless devices.

if WLAN_VENDOR_HISILICON
source "drivers/net/wireless/hisilicon/ws73/Kconfig"
endif
```

## drivers/net/wireless/hisilicon/ws73/Kconfig
```kconfig
# SPDX-License-Identifier: GPL-2.0-only
config WS73_WIFI_KUNIT_TEST
	tristate "WS73 Wi-Fi configuration tests" if !KUNIT_ALL_TESTS
	depends on KUNIT
	default KUNIT_ALL_TESTS
	help
	  Check bounded byte-oriented FRW configuration encoding and reply
	  parsing and bounded transactions in a hardware-free VM. No adapter or USB consumer is
	  registered. These tests do not qualify the original firmware ABI,
	  radio, security or Wi-Fi connectivity.
```
